/ {
    led_strip: led_strip {
        compatible = "sk6812";
        gpios = <&gpio0 6 GPIO_ACTIVE_HIGH>; // 🛠️ Set to your actual GPIO pin
        chain-length = <27>;                // 🛠️ Number of SK6812 LEDs
        label = "LED_STRIP";
    };
};

&zmk {
    underglow = &led_strip;
};
